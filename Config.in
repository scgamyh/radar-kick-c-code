## Config.in
```kconfig
config BR2_PACKAGE_AD936X_IIOSTREAM_SWITCH
	bool "AD936X_IIOSTREAM_SWITCH source app"
	select BR2_PACKAGE_FFTW
	select BR2_PACKAGE_FFTW_DOUBLE
	select BR2_PACKAGE_LIBIIO
	depends on BR2_TOOLCHAIN_HAS_THREADS
	help
	  eric AD936X_IIOSTREAM_SWITCH source app softer
```
